## main/Kconfig.projbuild
```kconfig
menu "TPTCM WiFi Bridge"

    config TPTCM_UART_PORT
        int "Printer UART port number"
        default 1
        range 1 2
        help
            UART peripheral connected to the printer through the
            SN74LVC1T45 level translators. UART0 is the debug
            console, do not use it.

    config TPTCM_UART_TX_GPIO
        int "UART TX GPIO (ESP32 -> SN74LVC1T45 -> printer RX)"
        default 15
        range 0 48
        help
            ESP_TX net on the schematic: U1 pin 8 (IO15) feeds the
            A side of the U2 level translator whose B side drives the
            printer RX pad (TP4).

    config TPTCM_UART_RX_GPIO
        int "UART RX GPIO (printer TX -> SN74LVC1T45 -> ESP32)"
        default 17
        range 0 48
        help
            ESP_RX net on the schematic: U1 pin 10 (IO17) is fed by the
            A side of the U3 level translator whose B side listens to
            the printer TX pad (TP5).

    config TPTCM_UART_BAUD
        int "UART baud rate"
        default 57600
        help
            Must match the baud rate configured on the printer
            (DIP switches). Common values: 9600, 57600, 115200.

    config TPTCM_TCP_PORT
        int "RAW TCP server port"
        default 9100
        help
            Port the TCP print server listens on. 9100 is the standard
            JetDirect RAW port used by Windows Standard TCP/IP Port.

    config TPTCM_ADMIN_PORT
        int "Admin page and OTA upload TCP port"
        default 80
        range 1 65535
        help
            Port of the admin web page served once the station has an
            IP: device info, firmware upload (POST /ota) and the log
            viewer. Open http://<device-ip>/ in a browser.

    config TPTCM_LOG_TCP_PORT
        int "Live log tail TCP port"
        default 3333
        range 1 65535
        help
            One-client TCP server streaming ESP_LOG output as plain
            text. Connect with PuTTY (connection type Raw) or nc.

    config TPTCM_LOG_RING_SIZE
        int "Captured log ring size in bytes"
        default 16384
        range 4096 65536
        help
            Bytes of ESP_LOG output kept in RAM for the remote log
            viewers (admin page and TCP tail).

    config TPTCM_LOG_TRAFFIC
        bool "Log TCP and printer UART traffic on the console"
        default y
        help
            Log every chunk received from a print client and every
            chunk queued to the printer UART, with a hex preview of the
            leading bytes. Keep enabled for bring-up and debugging;
            disable for a quiet console in production.

    config TPTCM_LOG_TRAFFIC_DUMP_BYTES
        int "Hex preview bytes per logged traffic chunk"
        default 24
        range 0 64
        depends on TPTCM_LOG_TRAFFIC
        help
            How many leading bytes of each chunk are rendered as hex in
            the traffic log lines. 0 logs only the byte counts.

    config TPTCM_WIFI_SSID
        string "Default WiFi SSID (optional)"
        default ""
        help
            WiFi network to join when no credentials are saved in NVS.
            Leave empty to always start the provisioning AP on first boot.

    config TPTCM_WIFI_PASSWORD
        string "Default WiFi password (optional)"
        default ""

    config TPTCM_STA_MAX_RETRY
        int "STA connect retries before starting provisioning AP"
        default 5
        range 1 20
        help
            After this many failed connection attempts with saved/default
            credentials the device additionally starts the provisioning
            access point so the network can be reconfigured.

    config TPTCM_AP_SSID
        string "Provisioning AP SSID"
        default "TPTCM60-Setup"

    config TPTCM_AP_PASSWORD
        string "Provisioning AP password"
        default "setup12345"
        help
            WPA2 password of the provisioning access point. Must be at
            least 8 characters, otherwise the AP starts open.

    config TPTCM_WIFI_MAX_TX_POWER
        int "WiFi max TX power in 0.25 dBm units"
        default 40
        range 8 84
        help
            40 = 10 dBm, 80 = 20 dBm (ESP32 default). At the default
            20 dBm the PA current spikes can sag the 3.3 V rail
            (AMS1117 fed from the printer 5 V pad) and distort the RF:
            known ESP32-S3 issue where the SoftAP beacons "start" in
            the log but stay invisible to phones (esp-idf#13508).
            10 dBm is plenty for a desk printer bridge.

endmenu
```
